## CMakeLists.txt
```
cmake_minimum_required(VERSION 3.20)
find_package(Zephyr REQUIRED HINTS $ENV{ZEPHYR_BASE})
project(klausscpu_ssh_shell)

target_sources(app PRIVATE src/main.c)
```

## prj.conf
```kconfig
# ── Core ──────────────────────────────────────────────────────────────────
CONFIG_BOARD_NEXYS_A7=y
CONFIG_XIP=n
CONFIG_DEBUG_INFO=n
CONFIG_SOC_KLAUSSCPU_NEXYS_A7=y
CONFIG_CBPRINTF_FP_SUPPORT=n
CONFIG_CBPRINTF_FP_A_SUPPORT=n

# ── UART ──────────────────────────────────────────────────────────────────
CONFIG_UART_KLAUSSCPU=y
CONFIG_UART_CONSOLE=y

# ── Timer ─────────────────────────────────────────────────────────────────
CONFIG_KLAUSSCPU_TIMER=y
CONFIG_SYS_CLOCK_HW_CYCLES_PER_SEC=100000000
# 1 kHz tick (was 100 Hz = 10 ms).  The eth RX driver polls with
# k_sleep(K_MSEC(1)), which rounds up to one tick — at 100 Hz that's a 10 ms
# poll, long enough for the 2-slot RX ring to overflow under broadcast load and
# drop single reply packets (ping/NTP replies).  1 kHz -> ~1 ms RX poll.
CONFIG_SYS_CLOCK_TICKS_PER_SEC=1000

# ── Networking ────────────────────────────────────────────────────────────
CONFIG_NETWORKING=y
CONFIG_NET_L2_ETHERNET=y
CONFIG_ETH_KLAUSSCPU=y
CONFIG_NET_IPV4=y
CONFIG_NET_IPV6=n
CONFIG_NET_DHCPV4=y
CONFIG_NET_SOCKETS=y
CONFIG_NET_SOCKETS_POSIX_NAMES=n
CONFIG_NET_TCP=y
CONFIG_NET_UDP=y
# SNTP (network time) + DNS so file timestamps are real (no RTC on the board).
CONFIG_DNS_RESOLVER=y
CONFIG_SNTP=y
# Network diagnostics shell: `net iface` / `net ping <ip>` / `net dns <host>` /
# `net route` / `net stats`.  NET_SHELL selects REQUIRES_FLOAT_PRINTF (ping RTT
# uses %f), so enable FP printf (soft-FP is available via compiler-rt).
CONFIG_NET_SHELL=y
CONFIG_CBPRINTF_FP_SUPPORT=y
CONFIG_NET_STATISTICS=y
# KlaussCPU's 64-bit pointers/longs make every stack frame larger than on a
# 32-bit target, so several stock net thread stacks overflow during packet
# processing and silently corrupt neighbouring memory (this manifested as a
# mangled node in a socket recv-queue poll list -> DNS/SNTP responses never
# dispatched).  The net RX traffic-class thread (rx_q[0], CONFIG_NET_RX_STACK_SIZE)
# overflowed handling an inbound packet.  Give the net + socket-service threads
# real headroom, and keep STACK_SENTINEL on to panic-name any future overflow.
CONFIG_NET_RX_STACK_SIZE=8192
CONFIG_NET_TX_STACK_SIZE=8192
CONFIG_NET_SOCKETS_SERVICE_STACK_SIZE=8192
CONFIG_NET_MGMT_EVENT_STACK_SIZE=8192
# tcp_work queue: overflowed during the wolfSSH handshake's TCP churn (the TCP
# state machine + net_pkt processing on 64-bit frames).  Default (~1200) is far
# too small here; size it with the rest.  HTTP + SFTP add more TCP load too.
CONFIG_NET_TCP_WORKQ_STACK_SIZE=8192
CONFIG_STACK_SENTINEL=y

# Network buffers.  lwIP works on this same board with a 2-slot ring, so the RX
# bottleneck is here, not the HW: the stock pools were ~5 full frames
# (BUF_RX_COUNT=32 x 256B; a 1500B frame needs 6 bufs), which the /22 broadcast
# burst exhausts -> net_pkt alloc fails -> frames (incl. replies) discarded.
# One 1536B buffer per frame + generous counts (RAM is plentiful).
CONFIG_NET_PKT_RX_COUNT=64
CONFIG_NET_PKT_TX_COUNT=32
CONFIG_NET_BUF_RX_COUNT=96
CONFIG_NET_BUF_TX_COUNT=48
CONFIG_NET_BUF_DATA_SIZE=1536

# Logging — immediate mode so messages appear in real time
CONFIG_LOG_MODE_IMMEDIATE=y
CONFIG_NET_LOG=y

# ── SD card + filesystem ─────────────────────────────────────────────────
CONFIG_DISK_ACCESS=y
CONFIG_DISK_KLAUSSCPU_SD=y
CONFIG_FILE_SYSTEM=y
CONFIG_FAT_FILESYSTEM_ELM=y
CONFIG_FS_FATFS_LFN=y
CONFIG_FS_FATFS_LFN_MODE_BSS=y
CONFIG_FS_FATFS_LFN=y
CONFIG_FS_FATFS_LFN_MODE_BSS=y
# `ls` calls FatFs f_stat directly (for timestamps) outside Zephyr's fs lock;
# reentrancy makes that safe against concurrent SD access from another session.
CONFIG_FS_FATFS_REENTRANT=y

# ── Shell (UART console) ─────────────────────────────────────────────────
CONFIG_SHELL=y
CONFIG_SHELL_BACKEND_SERIAL=y
# Log straight to the UART (synchronous) instead of via the shell's log backend.
# The shell backend processes logs on the shell thread, which is starved during
# boot/net init, so messages buffered and only flushed after DHCP.  Direct UART
# logging makes boot/early messages appear in real time on the serial console.
CONFIG_LOG_BACKEND_UART=y
CONFIG_SHELL_LOG_BACKEND=n
# Per-session prompt shows the cwd (set via shell_prompt_change).  40 is the
# Kconfig max for this buffer; cwds longer than ~36 chars are truncated with a
# leading '<' in shell_prompt_sync() (shell_paths.c).
CONFIG_SHELL_PROMPT_CHANGE=y
CONFIG_SHELL_PROMPT_BUFF_SIZE=40
CONFIG_DEVMEM_SHELL=n
CONFIG_KLAUSSCPU_SHELL_CMDS=y

# ── wolfSSL + wolfSSH (built from source as Zephyr modules) ──────────────
CONFIG_WOLFSSL=y
CONFIG_WOLFSSL_BUILTIN=y
CONFIG_WOLFSSL_SETTINGS_FILE="user_settings.h"
CONFIG_WOLFSSH=y
CONFIG_WOLFSSH_SETTINGS_FILE="user_settings.h"
CONFIG_WOLFSSH_SFTP_DEFAULT_DIR="/SD:"

# ── SSH server ────────────────────────────────────────────────────────────
CONFIG_KLAUSSCPU_SSH_SERVER=y
CONFIG_THREAD_MONITOR=y
CONFIG_THREAD_NAME=y

# ── HTTP file server (raw socket, :80, serves /SD:) ───────────────────────
CONFIG_KLAUSSCPU_HTTP_SERVER=y

# ── HTTPS file server (HTTP over TLS via wolfSSL, :443, serves /SD:) ───────
# Self-signed ECDSA P-256 cert generated on first boot and persisted to /SD:.
# TLS 1.2 + 1.3; reuses the HTTP request dispatch and wolfSSL (already built
# for SSH).
CONFIG_KLAUSSCPU_HTTPS_SERVER=y

# Socket/fd/context headroom: SSH (listener + up to SSH_MAX_CONNS conns) AND the
# HTTP server (listener + accepted socket) AND the HTTPS server (listener +
# accepted socket) AND DNS/UDP must coexist.  Every TCP listener and connection
# consumes a net_conn, so NET_MAX_CONN must cover them all (stock 4 / 6 are far
# too tight; "Not enough connection contexts" otherwise).
CONFIG_ZVFS_OPEN_MAX=28
CONFIG_POSIX_MAX_FDS=28
CONFIG_NET_MAX_CONTEXTS=28
CONFIG_NET_MAX_CONN=20
CONFIG_NET_SOCKETS_POLL_MAX=8

# ── LLEXT (runtime-loadable extensions; `run` command) ───────────────────
CONFIG_LLEXT=y
CONFIG_LLEXT_TYPE_ELF_OBJECT=y
CONFIG_LLEXT_HEAP_SIZE=256
# Quiet the per-relocation load trace on the UART; warnings/errors still show.
CONFIG_LLEXT_LOG_LEVEL_WRN=y
# Per-thread stdio routing for concurrent `run`s keys off thread custom data.
CONFIG_THREAD_CUSTOM_DATA=y

# libc malloc arena for extensions (minimal libc defaults this to 0 = no heap).
CONFIG_COMMON_LIBC_MALLOC_ARENA_SIZE=2097152

# ── Memory (126 MB RAM available — be generous) ──────────────────────────
CONFIG_HEAP_MEM_POOL_SIZE=524288
CONFIG_MAIN_STACK_SIZE=32768
CONFIG_SYSTEM_WORKQUEUE_STACK_SIZE=8192
# Shell-core thread stack. Each shell instance (serial + one per SSH slot) gets
# this. `run` executes loaded llext programs on the shell thread, so it must be
# large enough for the program + its callees (was the 40 KB SSH conn stack).
CONFIG_SHELL_STACK_SIZE=40960
CONFIG_LOG_PROCESS_THREAD_STACK_SIZE=2048
```

## src/main.c
```c
/*
 * main.c — KlaussCPU Zephyr SSH shell application.
 *
 * Boot: SD card mount → DHCP → NTP time → SSH server → shell on UART.
 */

#include <zephyr/kernel.h>
#include <zephyr/fs/fs.h>
#include <zephyr/storage/disk_access.h>
#include <ff.h>
#include <zephyr/net/net_if.h>
#include <zephyr/net/net_mgmt.h>
#include <zephyr/net/net_ip.h>
#include <zephyr/net/dhcpv4.h>
#include <zephyr/net/sntp.h>
#include <zephyr/logging/log.h>

#include "wallclock.h"

#ifdef CONFIG_KLAUSSCPU_SSH_SERVER
#include "ssh_server.h"
#endif

#ifdef CONFIG_KLAUSSCPU_HTTP_SERVER
#include "httpd.h"
#endif

#ifdef CONFIG_KLAUSSCPU_HTTPS_SERVER
#include "httpsd.h"
#endif

LOG_MODULE_REGISTER(main, LOG_LEVEL_INF);

/* No RTC on this board, so NTP is the time source for FatFs file timestamps.
 * pool.ntp.org rotates servers, so each sntp_simple() re-resolves to a fresh
 * one — retrying rides past a dud/unreachable pool entry or a dropped reply. */
#define NTP_SERVER       "pool.ntp.org"
#define NTP_TIMEOUT_MS   3000
#define NTP_BOOT_TRIES   3

/* ── FatFS mount ─────────────────────────────────────────────────────────── */

static FATFS fat_fs;

static struct fs_mount_t fatfs_mnt = {
	.type = FS_FATFS,
	.fs_data = &fat_fs,
	.mnt_point = "/SD:",
};

static int mount_sd(void)
{
	int rc = disk_access_init("SD");

	if (rc != 0) {
		LOG_ERR("SD init failed: %d", rc);
		return rc;
	}

	rc = fs_mount(&fatfs_mnt);
	if (rc != 0) {
		LOG_ERR("FatFS mount failed: %d", rc);
		return rc;
	}

	LOG_INF("SD card mounted at /SD:/");
	return 0;
}

/* ── DHCP ────────────────────────────────────────────────────────────────── */

static struct net_mgmt_event_callback dhcp_cb;
static struct k_sem dhcp_sem;

static void dhcp_handler(struct net_mgmt_event_callback *cb,
			 uint32_t mgmt_event, struct net_if *iface)
{
	if (mgmt_event != NET_EVENT_IPV4_DHCP_BOUND) {
		return;
	}

	char addr_str[NET_IPV4_ADDR_LEN];
	struct net_if_config *cfg = net_if_get_config(iface);

	if (cfg && cfg->ip.ipv4) {
		net_addr_ntop(AF_INET,
			      &cfg->ip.ipv4->unicast[0].ipv4.address.in_addr,
			      addr_str, sizeof(addr_str));
		LOG_INF("DHCP: %s", addr_str);
	}

	k_sem_give(&dhcp_sem);
}

static int wait_for_dhcp(void)
{
	k_sem_init(&dhcp_sem, 0, 1);

	net_mgmt_init_event_callback(&dhcp_cb, dhcp_handler,
				     NET_EVENT_IPV4_DHCP_BOUND);
	net_mgmt_add_event_callback(&dhcp_cb);

	struct net_if *iface = net_if_get_default();

	if (!iface) {
		LOG_ERR("No network interface");
		return -1;
	}

	net_dhcpv4_start(iface);

	if (k_sem_take(&dhcp_sem, K_SECONDS(10)) != 0) {
		LOG_WRN("DHCP timeout");
		return -1;
	}
	return 0;
}

/* ── Main ────────────────────────────────────────────────────────────────── */

int main(void)
{
	LOG_INF("KlaussCPU Zephyr SSH Shell");

	int sd_ok = (mount_sd() == 0);
	int net_ok = (wait_for_dhcp() == 0);

	/* Best-effort time at boot; the `ntp` shell command can re-sync, and
	 * `date <unix_epoch>` sets it manually. */
	if (net_ok) {
		struct sntp_time ts;
		bool got = false;

		for (int i = 0; i < NTP_BOOT_TRIES; i++) {
			if (sntp_simple(NTP_SERVER, NTP_TIMEOUT_MS, &ts) == 0) {
				wallclock_set(ts.seconds);
				LOG_INF("NTP: time set from %s", NTP_SERVER);
				got = true;
				break;
			}
		}

		if (!got) {
			LOG_WRN("NTP failed at boot; use `ntp [server]` or "
				"`date <unix_epoch>`");
		}
	}

#ifdef CONFIG_KLAUSSCPU_SSH_SERVER
	if (net_ok && sd_ok) {
		if (ssh_server_start() == 0) {
			LOG_INF("SSH ready on port 22");
		} else {
			LOG_ERR("SSH server failed");
		}
	}
#endif

#ifdef CONFIG_KLAUSSCPU_HTTP_SERVER
	if (net_ok && sd_ok) {
		httpd_start();
		LOG_INF("HTTP file server ready on port 80");
	}
#endif

#ifdef CONFIG_KLAUSSCPU_HTTPS_SERVER
	if (net_ok && sd_ok) {
		if (httpsd_start() == 0) {
			LOG_INF("HTTPS file server ready on port 443");
		} else {
			LOG_ERR("HTTPS server failed");
		}
	}
#endif

	LOG_INF("System ready");

	while (1) {
		k_sleep(K_SECONDS(60));
	}
	return 0;
}
```
