## llvm/lib/Target/KlaussCPU/runtime/zephyr-ws/klausscpu-zephyr/Kconfig
```kconfig
rsource "arch/klausscpu/Kconfig"
rsource "drivers/serial/Kconfig"
rsource "drivers/timer/Kconfig"
rsource "drivers/ethernet/Kconfig"
rsource "drivers/disk/Kconfig"
rsource "soc/klausscpu/nexys_a7/Kconfig"
rsource "ssh/Kconfig"
```

## llvm/lib/Target/KlaussCPU/runtime/zephyr-ws/klausscpu-zephyr/boards/klausscpu/nexys_a7/Kconfig.defconfig
```kconfig
if BOARD_NEXYS_A7

config BOARD
	default "nexys_a7"

config SYS_CLOCK_HW_CYCLES_PER_SEC
	default 100000000   # 100 MHz

# Enable the KlaussCPU UART as the console.
config UART_KLAUSSCPU
	default y

config UART_CONSOLE
	default y

# Enable the KlaussCPU timer.
config KLAUSSCPU_TIMER
	default y

config HEAP_MEM_POOL_SIZE
	default 65536

endif # BOARD_NEXYS_A7
```

## llvm/lib/Target/KlaussCPU/runtime/zephyr-ws/klausscpu-zephyr/drivers/disk/Kconfig
```kconfig
config DISK_KLAUSSCPU_SD
	bool "KlaussCPU SD card disk driver"
	default n
	depends on DISK_ACCESS
	help
	  SD card driver for the KlaussCPU MMIO SPI SD controller.
	  Registers as a Zephyr disk_access device for use with FatFS.

if DISK_KLAUSSCPU_SD

config DISK_KLAUSSCPU_SD_VOLUME_NAME
	string "Disk volume name"
	default "SD"

config DISK_KLAUSSCPU_SD_INIT_PRIORITY
	int "Init priority"
	default 90

config DISK_KLAUSSCPU_SD_LOG_LEVEL
	int "Log level (0=OFF, 1=ERR, 2=WRN, 3=INF, 4=DBG)"
	default 3
	range 0 4

endif # DISK_KLAUSSCPU_SD
```

## llvm/lib/Target/KlaussCPU/runtime/zephyr-ws/klausscpu-zephyr/drivers/ethernet/Kconfig
```kconfig
config ETH_KLAUSSCPU
	bool "KlaussCPU LiteEth Ethernet driver"
	default n
	depends on NET_L2_ETHERNET
	help
	  Ethernet driver for the KlaussCPU LiteEth MAC on Nexys A7.
	  Uses polled RX (no IRQ) and blocking TX via MMIO slot SRAM.

if ETH_KLAUSSCPU

config ETH_KLAUSSCPU_RX_STACK_SIZE
	int "RX polling thread stack size"
	default 4096

config ETH_KLAUSSCPU_RX_PRIO
	int "RX polling thread priority"
	default 2

config ETH_KLAUSSCPU_INIT_PRIORITY
	int "Init priority"
	default 80

config ETH_KLAUSSCPU_LOG_LEVEL
	int "Log level (0=OFF, 1=ERR, 2=WRN, 3=INF, 4=DBG)"
	default 3
	range 0 4

endif # ETH_KLAUSSCPU
```

## llvm/lib/Target/KlaussCPU/runtime/zephyr-ws/klausscpu-zephyr/drivers/serial/Kconfig
```kconfig
config UART_KLAUSSCPU
	bool "KlaussCPU UART driver"
	default n
	depends on SERIAL
	select SERIAL_HAS_DRIVER
	help
	  Polled UART driver for the KlaussCPU hardware UART.
	  Uses the klausscpu_txcharmemr / klausscpu_rxrb builtins.
```

## llvm/lib/Target/KlaussCPU/runtime/zephyr-ws/klausscpu-zephyr/drivers/timer/Kconfig
```kconfig
config KLAUSSCPU_TIMER
	bool "KlaussCPU system timer"
	default n
	help
	  System tick timer for the KlaussCPU MMIO interrupt controller.
	  Fixed-rate (10 kHz @ 100 MHz CPU); does NOT support tickless —
	  sys_clock_set_timeout() is a no-op and sys_clock_elapsed() returns 0.
	  Do NOT select TICKLESS_CAPABLE here, or k_msleep / timeouts won't fire.
```

## llvm/lib/Target/KlaussCPU/runtime/zephyr-ws/klausscpu-zephyr/dts/bindings/disk/klausscpu,sd.yaml
```yaml
description: KlaussCPU SD card SPI controller

compatible: "klausscpu,sd"

include: [base.yaml]

properties:
  reg:
    required: true
```

## llvm/lib/Target/KlaussCPU/runtime/zephyr-ws/klausscpu-zephyr/dts/bindings/ethernet/klausscpu,ethernet.yaml
```yaml
description: KlaussCPU LiteEth Ethernet MAC

compatible: "klausscpu,ethernet"

include: [base.yaml]

properties:
  reg:
    required: true
```

## llvm/lib/Target/KlaussCPU/runtime/zephyr-ws/klausscpu-zephyr/dts/bindings/serial/klausscpu,uart.yaml
```yaml
description: KlaussCPU UART (single MMIO TX/RX register)

compatible: "klausscpu,uart"

include: [uart-controller.yaml]

properties:
  reg:
    required: true
  current-speed:
    required: false
```

## llvm/lib/Target/KlaussCPU/runtime/zephyr-ws/klausscpu-zephyr/dts/bindings/timer/klausscpu,timer.yaml
```yaml
description: KlaussCPU timer and interrupt controller

compatible: "klausscpu,timer"

include: [base.yaml]

properties:
  reg:
    required: true
```

## llvm/lib/Target/KlaussCPU/runtime/zephyr-ws/klausscpu-zephyr/soc/klausscpu/nexys_a7/Kconfig.soc
```kconfig
config SOC_KLAUSSCPU_NEXYS_A7
	bool "KlaussCPU SoC on Nexys A7"
	select CPU_KLAUSSCPU
```

## llvm/lib/Target/KlaussCPU/runtime/zephyr-ws/klausscpu-zephyr/ssh/Kconfig
```kconfig
config KLAUSSCPU_SSH_SERVER
	bool "KlaussCPU SSH server"
	default n
	depends on NET_SOCKETS
	depends on DISK_KLAUSSCPU_SD
	help
	  SSH server using wolfSSH over Zephyr sockets.
	  Requires wolfSSL and wolfSSH libraries to be available.
	  Provides an interactive shell with filesystem and hardware commands.

config KLAUSSCPU_HTTP_SERVER
	bool "KlaussCPU HTTP file server"
	default n
	depends on NET_SOCKETS
	depends on FILE_SYSTEM
	help
	  Minimal raw-socket HTTP/1.0 file server on port 80 serving the SD card
	  (/SD:): GET downloads files / lists directories, PUT uploads files.
	  No auth or TLS — intended for trusted LAN use.

config KLAUSSCPU_HTTPS_SERVER
	bool "KlaussCPU HTTPS file server"
	default n
	depends on NET_SOCKETS
	depends on FILE_SYSTEM
	depends on WOLFSSL
	help
	  HTTP-over-TLS file server on port 443 serving the SD card (/SD:),
	  reusing the HTTP request dispatch.  Presents a self-signed ECDSA
	  P-256 certificate, generated on first boot and persisted to the SD
	  card.  Supports TLS 1.2 and 1.3.  No client-certificate auth.

config KLAUSSCPU_SHELL_CMDS
	bool "KlaussCPU shell commands"
	default y if SHELL
	depends on SHELL
	depends on FILE_SYSTEM
	help
	  Register filesystem and hardware commands with the Zephyr shell.
	  Available on the UART console independently of the SSH server.
```
