// Generated by gen-decoder-table.py from KlaussCPUMCCodeEmitter.cpp;
// do not edit.  {Opcode, Words, Template, Mask, NumFields, Fields}
{KlaussCPU::RET_I, 1, 0x65800000u, 0xFFFFFFFFu, 0, {}},
{KlaussCPU::LEAVE_I, 1, 0x66400000u, 0xFFFFFFFFu, 0, {}},
{KlaussCPU::LEAVERET_I, 1, 0x66800000u, 0xFFFFFFFFu, 0, {}},
{KlaussCPU::IRET_I, 1, 0x65C00000u, 0xFFFFFFFFu, 0, {}},
{KlaussCPU::NOP_I, 1, 0x6C000000u, 0xFFFFFFFFu, 0, {}},
{KlaussCPU::HALT_I, 1, 0x6C010000u, 0xFFFFFFFFu, 0, {}},
{KlaussCPU::WAIT_I, 1, 0x6C020000u, 0xFFFFFFFFu, 0, {}},
{KlaussCPU::TRAP_I, 1, 0x6C040000u, 0xFFFFFFFFu, 0, {}},
{KlaussCPU::JMP, 2, 0xA0000000u, 0xFFFFFFFFu, 1, {{F_W1U, 0}}},
{KlaussCPU::JMPZ, 2, 0xA0080000u, 0xFFFFFFFFu, 1, {{F_W1U, 0}}},
{KlaussCPU::JMPNZ, 2, 0xA00C0000u, 0xFFFFFFFFu, 1, {{F_W1U, 0}}},
{KlaussCPU::JMPC, 2, 0xA0100000u, 0xFFFFFFFFu, 1, {{F_W1U, 0}}},
{KlaussCPU::JMPNC, 2, 0xA0140000u, 0xFFFFFFFFu, 1, {{F_W1U, 0}}},
{KlaussCPU::JMPO, 2, 0xA0180000u, 0xFFFFFFFFu, 1, {{F_W1U, 0}}},
{KlaussCPU::JMPNO, 2, 0xA01C0000u, 0xFFFFFFFFu, 1, {{F_W1U, 0}}},
{KlaussCPU::JMPS, 2, 0xA0200000u, 0xFFFFFFFFu, 1, {{F_W1U, 0}}},
{KlaussCPU::JMPNS, 2, 0xA0240000u, 0xFFFFFFFFu, 1, {{F_W1U, 0}}},
{KlaussCPU::JMPLT, 2, 0xA0280000u, 0xFFFFFFFFu, 1, {{F_W1U, 0}}},
{KlaussCPU::JMPGE, 2, 0xA02C0000u, 0xFFFFFFFFu, 1, {{F_W1U, 0}}},
{KlaussCPU::JMPLE, 2, 0xA0300000u, 0xFFFFFFFFu, 1, {{F_W1U, 0}}},
{KlaussCPU::JMPGT, 2, 0xA0340000u, 0xFFFFFFFFu, 1, {{F_W1U, 0}}},
{KlaussCPU::JMPULT, 2, 0xA0380000u, 0xFFFFFFFFu, 1, {{F_W1U, 0}}},
{KlaussCPU::JMPUGE, 2, 0xA03C0000u, 0xFFFFFFFFu, 1, {{F_W1U, 0}}},
{KlaussCPU::JMPULE, 2, 0xA0400000u, 0xFFFFFFFFu, 1, {{F_W1U, 0}}},
{KlaussCPU::JMPUGT, 2, 0xA0440000u, 0xFFFFFFFFu, 1, {{F_W1U, 0}}},
{KlaussCPU::JMPE, 2, 0xA0480000u, 0xFFFFFFFFu, 1, {{F_W1U, 0}}},
{KlaussCPU::JMPNE, 2, 0xA04C0000u, 0xFFFFFFFFu, 1, {{F_W1U, 0}}},
{KlaussCPU::CALL_I, 2, 0xA2000000u, 0xFFFFFFFFu, 1, {{F_W1U, 0}}},
{KlaussCPU::CALLZ, 2, 0xA2080000u, 0xFFFFFFFFu, 1, {{F_W1U, 0}}},
{KlaussCPU::CALLNZ, 2, 0xA20C0000u, 0xFFFFFFFFu, 1, {{F_W1U, 0}}},
{KlaussCPU::CALLC, 2, 0xA2100000u, 0xFFFFFFFFu, 1, {{F_W1U, 0}}},
{KlaussCPU::CALLNC, 2, 0xA2140000u, 0xFFFFFFFFu, 1, {{F_W1U, 0}}},
{KlaussCPU::CALLO, 2, 0xA2180000u, 0xFFFFFFFFu, 1, {{F_W1U, 0}}},
{KlaussCPU::CALLNO, 2, 0xA21C0000u, 0xFFFFFFFFu, 1, {{F_W1U, 0}}},
{KlaussCPU::CALLE, 2, 0xA2480000u, 0xFFFFFFFFu, 1, {{F_W1U, 0}}},
{KlaussCPU::CALLNE, 2, 0xA24C0000u, 0xFFFFFFFFu, 1, {{F_W1U, 0}}},
{KlaussCPU::JMPREL, 2, 0xA1000000u, 0xFFFFFFFFu, 1, {{F_W1PC, 0}}},
{KlaussCPU::JMPZREL, 2, 0xA1080000u, 0xFFFFFFFFu, 1, {{F_W1PC, 0}}},
{KlaussCPU::JMPNZREL, 2, 0xA10C0000u, 0xFFFFFFFFu, 1, {{F_W1PC, 0}}},
{KlaussCPU::JMPCREL, 2, 0xA1100000u, 0xFFFFFFFFu, 1, {{F_W1PC, 0}}},
{KlaussCPU::JMPNCREL, 2, 0xA1140000u, 0xFFFFFFFFu, 1, {{F_W1PC, 0}}},
{KlaussCPU::JMPSREL, 2, 0xA1200000u, 0xFFFFFFFFu, 1, {{F_W1PC, 0}}},
{KlaussCPU::JMPNSREL, 2, 0xA1240000u, 0xFFFFFFFFu, 1, {{F_W1PC, 0}}},
{KlaussCPU::JMPLTREL, 2, 0xA1280000u, 0xFFFFFFFFu, 1, {{F_W1PC, 0}}},
{KlaussCPU::JMPGEREL, 2, 0xA12C0000u, 0xFFFFFFFFu, 1, {{F_W1PC, 0}}},
{KlaussCPU::JMPLEREL, 2, 0xA1300000u, 0xFFFFFFFFu, 1, {{F_W1PC, 0}}},
{KlaussCPU::JMPGTREL, 2, 0xA1340000u, 0xFFFFFFFFu, 1, {{F_W1PC, 0}}},
{KlaussCPU::JMPULTREL, 2, 0xA1380000u, 0xFFFFFFFFu, 1, {{F_W1PC, 0}}},
{KlaussCPU::JMPUGEREL, 2, 0xA13C0000u, 0xFFFFFFFFu, 1, {{F_W1PC, 0}}},
{KlaussCPU::JMPULEREL, 2, 0xA1400000u, 0xFFFFFFFFu, 1, {{F_W1PC, 0}}},
{KlaussCPU::JMPUGTREL, 2, 0xA1440000u, 0xFFFFFFFFu, 1, {{F_W1PC, 0}}},
{KlaussCPU::JMPEREL, 2, 0xA1480000u, 0xFFFFFFFFu, 1, {{F_W1PC, 0}}},
{KlaussCPU::JMPNEREL, 2, 0xA14C0000u, 0xFFFFFFFFu, 1, {{F_W1PC, 0}}},
{KlaussCPU::CALLREL, 2, 0xA3000000u, 0xFFFFFFFFu, 1, {{F_W1PC, 0}}},
{KlaussCPU::ADDSP_I, 2, 0xA5400000u, 0xFFFFFFFFu, 1, {{F_W1S, 0}}},
{KlaussCPU::PUSHV, 2, 0xA4400000u, 0xFFFFFFFFu, 1, {{F_W1U, 0}}},
{KlaussCPU::DELAYV, 2, 0xAC050000u, 0xFFFFFFFFu, 1, {{F_W1S, 0}}},
{KlaussCPU::LCDCMDV, 2, 0xB0000000u, 0xFFFFFFFFu, 1, {{F_W1S, 0}}},
{KlaussCPU::LCDDATAV, 2, 0xB1000000u, 0xFFFFFFFFu, 1, {{F_W1S, 0}}},
{KlaussCPU::LCD, 2, 0xB2000000u, 0xFFFFFFFFu, 1, {{F_W1S, 0}}},
{KlaussCPU::PUSHV64, 3, 0xE4400000u, 0xFFFFFFFFu, 2, {{F_W1S, 0}, {F_W2S, 1}}},
{KlaussCPU::SETFR, 1, 0x57000000u, 0xFFFFF0FFu, 1, {{F_RD, 0}}},
{KlaussCPU::PUSH_R, 1, 0x64000000u, 0xFFFFFF0Fu, 1, {{F_RS1, 0}}},
{KlaussCPU::POP_R, 1, 0x64800000u, 0xFFFFF0FFu, 1, {{F_RD, 0}}},
{KlaussCPU::GETSP_R, 1, 0x64C00000u, 0xFFFFF0FFu, 1, {{F_RD, 0}}},
{KlaussCPU::SETSP_R, 1, 0x65000000u, 0xFFFFFF0Fu, 1, {{F_RS1, 0}}},
{KlaussCPU::JMPR_R, 1, 0x60800000u, 0xFFFFFFF0u, 1, {{F_RS2, 0}}},
{KlaussCPU::CALLR_R, 1, 0x62800000u, 0xFFFFFFF0u, 1, {{F_RS2, 0}}},
{KlaussCPU::DELAYR, 1, 0x6C050000u, 0xFFFFFF0Fu, 1, {{F_RS1, 0}}},
{KlaussCPU::LCDDATAR, 1, 0x71000000u, 0xFFFFFF0Fu, 1, {{F_RS1, 0}}},
{KlaussCPU::SETR, 2, 0x8BD00000u, 0xFFFFF0FFu, 2, {{F_RD, 0}, {F_W1S, 1}}},
{KlaussCPU::LEAPC, 2, 0x8B800000u, 0xFFFFF0FFu, 2, {{F_RD, 0}, {F_W1PC, 1}}},
{KlaussCPU::CMPRV_I, 2, 0x8C100000u, 0xFFFFFF0Fu, 2, {{F_RS1, 0}, {F_W1S, 1}}},
{KlaussCPU::CMPRVW_I, 2, 0x8C180000u, 0xFFFFFF0Fu, 2, {{F_RS1, 0}, {F_W1S, 1}}},
{KlaussCPU::MEMREADR, 2, 0x9B400000u, 0xFFFFF0FFu, 2, {{F_RD, 0}, {F_W1U, 1}}},
{KlaussCPU::MEMSETR, 2, 0x9F400000u, 0xFFFFF0FFu, 2, {{F_RD, 0}, {F_W1U, 1}}},
{KlaussCPU::SETR64, 3, 0xCBC00000u, 0xFFFFF0FFu, 3, {{F_RD, 0}, {F_W1S, 1}, {F_W2S, 2}}},
{KlaussCPU::COPY_R, 1, 0x54000000u, 0xFFFFF00Fu, 2, {{F_RD, 0}, {F_RS1, 1}}},
{KlaussCPU::NEGR, 1, 0x54480000u, 0xFFFFF00Fu, 2, {{F_RD, 0}, {F_RS1, 1}}},
{KlaussCPU::NOTR, 1, 0x54880000u, 0xFFFFF00Fu, 2, {{F_RD, 0}, {F_RS1, 1}}},
{KlaussCPU::ABSR, 1, 0x54C80000u, 0xFFFFF00Fu, 2, {{F_RD, 0}, {F_RS1, 1}}},
{KlaussCPU::SEXTB, 1, 0x55080000u, 0xFFFFF00Fu, 2, {{F_RD, 0}, {F_RS1, 1}}},
{KlaussCPU::SEXTH, 1, 0x55180000u, 0xFFFFF00Fu, 2, {{F_RD, 0}, {F_RS1, 1}}},
{KlaussCPU::SEXTW, 1, 0x55200000u, 0xFFFFF00Fu, 2, {{F_RD, 0}, {F_RS1, 1}}},
{KlaussCPU::ZEXTB, 1, 0x55480000u, 0xFFFFF00Fu, 2, {{F_RD, 0}, {F_RS1, 1}}},
{KlaussCPU::ZEXTH, 1, 0x55580000u, 0xFFFFF00Fu, 2, {{F_RD, 0}, {F_RS1, 1}}},
{KlaussCPU::ZEXTW, 1, 0x55600000u, 0xFFFFF00Fu, 2, {{F_RD, 0}, {F_RS1, 1}}},
{KlaussCPU::BSWAP_R, 1, 0x55800000u, 0xFFFFF00Fu, 2, {{F_RD, 0}, {F_RS1, 1}}},
{KlaussCPU::BITREV, 1, 0x55C00000u, 0xFFFFF00Fu, 2, {{F_RD, 0}, {F_RS1, 1}}},
{KlaussCPU::POPCNT, 1, 0x56080000u, 0xFFFFF00Fu, 2, {{F_RD, 0}, {F_RS1, 1}}},
{KlaussCPU::CLZ, 1, 0x56400000u, 0xFFFFF00Fu, 2, {{F_RD, 0}, {F_RS1, 1}}},
{KlaussCPU::CTZ, 1, 0x56800000u, 0xFFFFF00Fu, 2, {{F_RD, 0}, {F_RS1, 1}}},
{KlaussCPU::INCR, 1, 0x57880000u, 0xFFFFF00Fu, 2, {{F_RD, 0}, {F_RS1, 1}}},
{KlaussCPU::DECR, 1, 0x57C80000u, 0xFFFFF00Fu, 2, {{F_RD, 0}, {F_RS1, 1}}},
{KlaussCPU::SHLR1, 1, 0x50208000u, 0xFFFFF00Fu, 2, {{F_RD, 0}, {F_RS1, 1}}},
{KlaussCPU::SHRR1, 1, 0x50608000u, 0xFFFFF00Fu, 2, {{F_RD, 0}, {F_RS1, 1}}},
{KlaussCPU::SHRAR, 1, 0x50A08000u, 0xFFFFF00Fu, 2, {{F_RD, 0}, {F_RS1, 1}}},
{KlaussCPU::ROLR1, 1, 0x50E0C000u, 0xFFFFF00Fu, 2, {{F_RD, 0}, {F_RS1, 1}}},
{KlaussCPU::RORR1, 1, 0x5120C000u, 0xFFFFF00Fu, 2, {{F_RD, 0}, {F_RS1, 1}}},
{KlaussCPU::ROLCR, 1, 0x5160C000u, 0xFFFFF00Fu, 2, {{F_RD, 0}, {F_RS1, 1}}},
{KlaussCPU::RORCR, 1, 0x51A0C000u, 0xFFFFF00Fu, 2, {{F_RD, 0}, {F_RS1, 1}}},
{KlaussCPU::MEMGET8, 1, 0x58000000u, 0xFFFFF00Fu, 2, {{F_RD, 0}, {F_RS1, 1}}},
{KlaussCPU::MEMGET16, 1, 0x59000000u, 0xFFFFF00Fu, 2, {{F_RD, 0}, {F_RS1, 1}}},
{KlaussCPU::MEMGET32, 1, 0x5A000000u, 0xFFFFF00Fu, 2, {{F_RD, 0}, {F_RS1, 1}}},
{KlaussCPU::MEMREADRR, 1, 0x5B000000u, 0xFFFFF00Fu, 2, {{F_RD, 0}, {F_RS1, 1}}},
{KlaussCPU::MEMGET64, 1, 0x5B100000u, 0xFFFFF00Fu, 2, {{F_RD, 0}, {F_RS1, 1}}},
{KlaussCPU::MEMSET8, 1, 0x5C000000u, 0xFFFFF00Fu, 2, {{F_RD, 0}, {F_RS1, 1}}},
{KlaussCPU::MEMSET16, 1, 0x5D000000u, 0xFFFFF00Fu, 2, {{F_RD, 0}, {F_RS1, 1}}},
{KlaussCPU::MEMSET32, 1, 0x5E000000u, 0xFFFFF00Fu, 2, {{F_RD, 0}, {F_RS1, 1}}},
{KlaussCPU::MEMSET64RR, 1, 0x5F000000u, 0xFFFFF00Fu, 2, {{F_RD, 0}, {F_RS1, 1}}},
{KlaussCPU::MEMSET64, 1, 0x5F100000u, 0xFFFFF00Fu, 2, {{F_RD, 0}, {F_RS1, 1}}},
{KlaussCPU::CMPRR_I, 1, 0x4C000000u, 0xFFFFFF00u, 2, {{F_RS1, 0}, {F_RS2, 1}}},
{KlaussCPU::CMPRRW_I, 1, 0x4C080000u, 0xFFFFFF00u, 2, {{F_RS1, 0}, {F_RS2, 1}}},
{KlaussCPU::ADDI, 2, 0x88300000u, 0xFFFFF00Fu, 3, {{F_RD, 0}, {F_RS1, 1}, {F_W1S, 2}}},
{KlaussCPU::ADDIW, 2, 0x88380000u, 0xFFFFF00Fu, 3, {{F_RD, 0}, {F_RS1, 1}, {F_W1S, 2}}},
{KlaussCPU::ADDV, 2, 0x88200000u, 0xFFFFF00Fu, 3, {{F_RD, 0}, {F_RS1, 1}, {F_W1U, 2}}},
{KlaussCPU::MINUSV, 2, 0x88600000u, 0xFFFFF00Fu, 3, {{F_RD, 0}, {F_RS1, 1}, {F_W1U, 2}}},
{KlaussCPU::ANDV, 2, 0x89000000u, 0xFFFFF00Fu, 3, {{F_RD, 0}, {F_RS1, 1}, {F_W1U, 2}}},
{KlaussCPU::ORV, 2, 0x89400000u, 0xFFFFF00Fu, 3, {{F_RD, 0}, {F_RS1, 1}, {F_W1U, 2}}},
{KlaussCPU::XORV, 2, 0x89800000u, 0xFFFFF00Fu, 3, {{F_RD, 0}, {F_RS1, 1}, {F_W1U, 2}}},
{KlaussCPU::MULV, 2, 0xA8800000u, 0xFFFFF00Fu, 3, {{F_RD, 0}, {F_RS1, 1}, {F_W1S, 2}}},
{KlaussCPU::DIVV, 2, 0xA9800000u, 0xFFFFF00Fu, 3, {{F_RD, 0}, {F_RS1, 1}, {F_W1S, 2}}},
{KlaussCPU::MODV, 2, 0xAA800000u, 0xFFFFF00Fu, 3, {{F_RD, 0}, {F_RS1, 1}, {F_W1S, 2}}},
{KlaussCPU::BEXTR, 2, 0x93000000u, 0xFFFFF00Fu, 3, {{F_RD, 0}, {F_RS1, 1}, {F_W1S, 2}}},
{KlaussCPU::BDEP, 2, 0x93400000u, 0xFFFFF00Fu, 3, {{F_RD, 0}, {F_RS1, 1}, {F_W1S, 2}}},
{KlaussCPU::LDIDX8, 2, 0x98200000u, 0xFFFFF00Fu, 3, {{F_RD, 0}, {F_RS1, 1}, {F_W1S, 2}}},
{KlaussCPU::LDIDX8_S, 2, 0x98A00000u, 0xFFFFF00Fu, 3, {{F_RD, 0}, {F_RS1, 1}, {F_W1S, 2}}},
{KlaussCPU::LDIDX16, 2, 0x99200000u, 0xFFFFF00Fu, 3, {{F_RD, 0}, {F_RS1, 1}, {F_W1S, 2}}},
{KlaussCPU::LDIDX16_S, 2, 0x99A00000u, 0xFFFFF00Fu, 3, {{F_RD, 0}, {F_RS1, 1}, {F_W1S, 2}}},
{KlaussCPU::LDIDX32, 2, 0x9A200000u, 0xFFFFF00Fu, 3, {{F_RD, 0}, {F_RS1, 1}, {F_W1S, 2}}},
{KlaussCPU::LDIDX32_S, 2, 0x9AA00000u, 0xFFFFF00Fu, 3, {{F_RD, 0}, {F_RS1, 1}, {F_W1S, 2}}},
{KlaussCPU::LDIDX64, 2, 0x9B300000u, 0xFFFFF00Fu, 3, {{F_RD, 0}, {F_RS1, 1}, {F_W1S, 2}}},
{KlaussCPU::LDIDX64U, 2, 0x9B200000u, 0xFFFFF00Fu, 3, {{F_RD, 0}, {F_RS1, 1}, {F_W1S, 2}}},
{KlaussCPU::STIDX8, 2, 0x9C200000u, 0xFFFFF00Fu, 3, {{F_RD, 0}, {F_RS1, 1}, {F_W1S, 2}}},
{KlaussCPU::STIDX16, 2, 0x9D200000u, 0xFFFFF00Fu, 3, {{F_RD, 0}, {F_RS1, 1}, {F_W1S, 2}}},
{KlaussCPU::STIDX32, 2, 0x9E200000u, 0xFFFFF00Fu, 3, {{F_RD, 0}, {F_RS1, 1}, {F_W1S, 2}}},
{KlaussCPU::STIDX64, 2, 0x9F300000u, 0xFFFFF00Fu, 3, {{F_RD, 0}, {F_RS1, 1}, {F_W1S, 2}}},
{KlaussCPU::STIDX64U, 2, 0x9F200000u, 0xFFFFF00Fu, 3, {{F_RD, 0}, {F_RS1, 1}, {F_W1S, 2}}},
{KlaussCPU::SHLAR, 1, 0x50208000u, 0xFFFFF00Fu, 2, {{F_RD, 0}, {F_RS1, 1}}},
{KlaussCPU::BTST, 1, 0x52E00000u, 0xFFE07F0Fu, 2, {{F_RS1, 0}, {F_N6, 1}}},
{KlaussCPU::ADDR, 1, 0x44200000u, 0xFFFFF000u, 3, {{F_RD, 0}, {F_RS1, 1}, {F_RS2, 2}}},
{KlaussCPU::SUBR, 1, 0x44600000u, 0xFFFFF000u, 3, {{F_RD, 0}, {F_RS1, 1}, {F_RS2, 2}}},
{KlaussCPU::ADDW, 1, 0x44280000u, 0xFFFFF000u, 3, {{F_RD, 0}, {F_RS1, 1}, {F_RS2, 2}}},
{KlaussCPU::SUBW, 1, 0x44680000u, 0xFFFFF000u, 3, {{F_RD, 0}, {F_RS1, 1}, {F_RS2, 2}}},
{KlaussCPU::MULW, 1, 0x68880000u, 0xFFFFF000u, 3, {{F_RD, 0}, {F_RS1, 1}, {F_RS2, 2}}},
{KlaussCPU::ADDC, 1, 0x44A00000u, 0xFFFFF000u, 3, {{F_RD, 0}, {F_RS1, 1}, {F_RS2, 2}}},
{KlaussCPU::SUBC, 1, 0x44E00000u, 0xFFFFF000u, 3, {{F_RD, 0}, {F_RS1, 1}, {F_RS2, 2}}},
{KlaussCPU::ANDR, 1, 0x45000000u, 0xFFFFF000u, 3, {{F_RD, 0}, {F_RS1, 1}, {F_RS2, 2}}},
{KlaussCPU::ORR, 1, 0x45400000u, 0xFFFFF000u, 3, {{F_RD, 0}, {F_RS1, 1}, {F_RS2, 2}}},
{KlaussCPU::XORR, 1, 0x45800000u, 0xFFFFF000u, 3, {{F_RD, 0}, {F_RS1, 1}, {F_RS2, 2}}},
{KlaussCPU::MINR, 1, 0x45C00000u, 0xFFFFF000u, 3, {{F_RD, 0}, {F_RS1, 1}, {F_RS2, 2}}},
{KlaussCPU::MAXR, 1, 0x46000000u, 0xFFFFF000u, 3, {{F_RD, 0}, {F_RS1, 1}, {F_RS2, 2}}},
{KlaussCPU::MINUR, 1, 0x46400000u, 0xFFFFF000u, 3, {{F_RD, 0}, {F_RS1, 1}, {F_RS2, 2}}},
{KlaussCPU::MAXUR, 1, 0x46800000u, 0xFFFFF000u, 3, {{F_RD, 0}, {F_RS1, 1}, {F_RS2, 2}}},
{KlaussCPU::MULUR, 1, 0x68000000u, 0xFFFFF000u, 3, {{F_RD, 0}, {F_RS1, 1}, {F_RS2, 2}}},
{KlaussCPU::MULHUR, 1, 0x68400000u, 0xFFFFF000u, 3, {{F_RD, 0}, {F_RS1, 1}, {F_RS2, 2}}},
{KlaussCPU::MULR, 1, 0x68800000u, 0xFFFFF000u, 3, {{F_RD, 0}, {F_RS1, 1}, {F_RS2, 2}}},
{KlaussCPU::MULHR, 1, 0x68C00000u, 0xFFFFF000u, 3, {{F_RD, 0}, {F_RS1, 1}, {F_RS2, 2}}},
{KlaussCPU::DIVUR, 1, 0x69000000u, 0xFFFFF000u, 3, {{F_RD, 0}, {F_RS1, 1}, {F_RS2, 2}}},
{KlaussCPU::DIVR, 1, 0x69800000u, 0xFFFFF000u, 3, {{F_RD, 0}, {F_RS1, 1}, {F_RS2, 2}}},
{KlaussCPU::MODUR, 1, 0x6A000000u, 0xFFFFF000u, 3, {{F_RD, 0}, {F_RS1, 1}, {F_RS2, 2}}},
{KlaussCPU::MODR, 1, 0x6A800000u, 0xFFFFF000u, 3, {{F_RD, 0}, {F_RS1, 1}, {F_RS2, 2}}},
{KlaussCPU::SHLR, 1, 0x50004000u, 0xFFFFF000u, 3, {{F_RD, 0}, {F_RS1, 1}, {F_RS2, 2}}},
{KlaussCPU::SHRR, 1, 0x50404000u, 0xFFFFF000u, 3, {{F_RD, 0}, {F_RS1, 1}, {F_RS2, 2}}},
{KlaussCPU::SARR, 1, 0x50804000u, 0xFFFFF000u, 3, {{F_RD, 0}, {F_RS1, 1}, {F_RS2, 2}}},
{KlaussCPU::ROLR, 1, 0x50C04000u, 0xFFFFF000u, 3, {{F_RD, 0}, {F_RS1, 1}, {F_RS2, 2}}},
{KlaussCPU::RORR_R, 1, 0x51004000u, 0xFFFFF000u, 3, {{F_RD, 0}, {F_RS1, 1}, {F_RS2, 2}}},
{KlaussCPU::BSETRR, 1, 0x52000000u, 0xFFFFF000u, 3, {{F_RD, 0}, {F_RS1, 1}, {F_RS2, 2}}},
{KlaussCPU::BCLRRR, 1, 0x52400000u, 0xFFFFF000u, 3, {{F_RD, 0}, {F_RS1, 1}, {F_RS2, 2}}},
{KlaussCPU::BTGLRR, 1, 0x52800000u, 0xFFFFF000u, 3, {{F_RD, 0}, {F_RS1, 1}, {F_RS2, 2}}},
{KlaussCPU::BTSTRR, 1, 0x52C00000u, 0xFFFFF000u, 3, {{F_RD, 0}, {F_RS1, 1}, {F_RS2, 2}}},
{KlaussCPU::CMPEQR, 1, 0x4C200000u, 0xFFFFF000u, 3, {{F_RD, 0}, {F_RS1, 1}, {F_RS2, 2}}},
{KlaussCPU::CMPNER, 1, 0x4C600000u, 0xFFFFF000u, 3, {{F_RD, 0}, {F_RS1, 1}, {F_RS2, 2}}},
{KlaussCPU::CMPLTR, 1, 0x4CA00000u, 0xFFFFF000u, 3, {{F_RD, 0}, {F_RS1, 1}, {F_RS2, 2}}},
{KlaussCPU::CMPGER, 1, 0x4CE00000u, 0xFFFFF000u, 3, {{F_RD, 0}, {F_RS1, 1}, {F_RS2, 2}}},
{KlaussCPU::CMPLER, 1, 0x4D200000u, 0xFFFFF000u, 3, {{F_RD, 0}, {F_RS1, 1}, {F_RS2, 2}}},
{KlaussCPU::CMPGTR, 1, 0x4D600000u, 0xFFFFF000u, 3, {{F_RD, 0}, {F_RS1, 1}, {F_RS2, 2}}},
{KlaussCPU::CMPULTR, 1, 0x4DA00000u, 0xFFFFF000u, 3, {{F_RD, 0}, {F_RS1, 1}, {F_RS2, 2}}},
{KlaussCPU::CMPUGER, 1, 0x4DE00000u, 0xFFFFF000u, 3, {{F_RD, 0}, {F_RS1, 1}, {F_RS2, 2}}},
{KlaussCPU::CMPULER, 1, 0x4E200000u, 0xFFFFF000u, 3, {{F_RD, 0}, {F_RS1, 1}, {F_RS2, 2}}},
{KlaussCPU::CMPUGTR, 1, 0x4E600000u, 0xFFFFF000u, 3, {{F_RD, 0}, {F_RS1, 1}, {F_RS2, 2}}},
{KlaussCPU::LDIDX64R, 1, 0x5B600000u, 0xFFFFF000u, 3, {{F_RD, 0}, {F_RS1, 1}, {F_RS2, 2}}},
{KlaussCPU::STIDX64R, 1, 0x5F600000u, 0xFFFFF000u, 3, {{F_RD, 0}, {F_RS1, 1}, {F_RS2, 2}}},
{KlaussCPU::SETR_SH, 1, 0x4BD00000u, 0xFFF000FFu, 2, {{F_RD, 0}, {F_SH_S, 1}}},
{KlaussCPU::CMPRV_SH, 1, 0x4C100000u, 0xFFF00F0Fu, 2, {{F_RS1, 0}, {F_SH_S, 1}}},
{KlaussCPU::SHLV, 1, 0x50204000u, 0xFFE0700Fu, 3, {{F_RD, 0}, {F_RS1, 1}, {F_N6, 2}}},
{KlaussCPU::SHRV, 1, 0x50604000u, 0xFFE0700Fu, 3, {{F_RD, 0}, {F_RS1, 1}, {F_N6, 2}}},
{KlaussCPU::SHRAV, 1, 0x50A04000u, 0xFFE0700Fu, 3, {{F_RD, 0}, {F_RS1, 1}, {F_N6, 2}}},
{KlaussCPU::ROLV, 1, 0x50E04000u, 0xFFE0700Fu, 3, {{F_RD, 0}, {F_RS1, 1}, {F_N6, 2}}},
{KlaussCPU::RORV, 1, 0x51204000u, 0xFFE0700Fu, 3, {{F_RD, 0}, {F_RS1, 1}, {F_N6, 2}}},
{KlaussCPU::BSET, 1, 0x52200000u, 0xFFE0700Fu, 3, {{F_RD, 0}, {F_RS1, 1}, {F_N6, 2}}},
{KlaussCPU::BCLR, 1, 0x52600000u, 0xFFE0700Fu, 3, {{F_RD, 0}, {F_RS1, 1}, {F_N6, 2}}},
{KlaussCPU::BTGL, 1, 0x52A00000u, 0xFFE0700Fu, 3, {{F_RD, 0}, {F_RS1, 1}, {F_N6, 2}}},
{KlaussCPU::ADDI_SH, 1, 0x48300000u, 0xFFF0000Fu, 3, {{F_RD, 0}, {F_RS1, 1}, {F_SH_S, 2}}},
{KlaussCPU::ADDV_SH, 1, 0x48200000u, 0xFFF0000Fu, 3, {{F_RD, 0}, {F_RS1, 1}, {F_SH_Z, 2}}},
{KlaussCPU::MINUSV_SH, 1, 0x48600000u, 0xFFF0000Fu, 3, {{F_RD, 0}, {F_RS1, 1}, {F_SH_Z, 2}}},
{KlaussCPU::ANDV_SH, 1, 0x49000000u, 0xFFF0000Fu, 3, {{F_RD, 0}, {F_RS1, 1}, {F_SH_Z, 2}}},
{KlaussCPU::ORV_SH, 1, 0x49400000u, 0xFFF0000Fu, 3, {{F_RD, 0}, {F_RS1, 1}, {F_SH_Z, 2}}},
{KlaussCPU::XORV_SH, 1, 0x49800000u, 0xFFF0000Fu, 3, {{F_RD, 0}, {F_RS1, 1}, {F_SH_Z, 2}}},
{KlaussCPU::LDIDX8_SH, 1, 0x58200000u, 0xFFF0000Fu, 3, {{F_RD, 0}, {F_RS1, 1}, {F_SH_M0, 2}}},
{KlaussCPU::LDIDX8_S_SH, 1, 0x58A00000u, 0xFFF0000Fu, 3, {{F_RD, 0}, {F_RS1, 1}, {F_SH_M0, 2}}},
{KlaussCPU::LDIDX16_SH, 1, 0x59200000u, 0xFFF0000Fu, 3, {{F_RD, 0}, {F_RS1, 1}, {F_SH_M1, 2}}},
{KlaussCPU::LDIDX16_S_SH, 1, 0x59A00000u, 0xFFF0000Fu, 3, {{F_RD, 0}, {F_RS1, 1}, {F_SH_M1, 2}}},
{KlaussCPU::LDIDX32_SH, 1, 0x5A200000u, 0xFFF0000Fu, 3, {{F_RD, 0}, {F_RS1, 1}, {F_SH_M2, 2}}},
{KlaussCPU::LDIDX32_S_SH, 1, 0x5AA00000u, 0xFFF0000Fu, 3, {{F_RD, 0}, {F_RS1, 1}, {F_SH_M2, 2}}},
{KlaussCPU::LDIDX64_SH, 1, 0x5B300000u, 0xFFF0000Fu, 3, {{F_RD, 0}, {F_RS1, 1}, {F_SH_M3, 2}}},
{KlaussCPU::LDIDX64U_SH, 1, 0x5B200000u, 0xFFF0000Fu, 3, {{F_RD, 0}, {F_RS1, 1}, {F_SH_M3, 2}}},
{KlaussCPU::STIDX8_SH, 1, 0x5C200000u, 0xFFF0000Fu, 3, {{F_RD, 0}, {F_RS1, 1}, {F_SH_M0, 2}}},
{KlaussCPU::STIDX16_SH, 1, 0x5D200000u, 0xFFF0000Fu, 3, {{F_RD, 0}, {F_RS1, 1}, {F_SH_M1, 2}}},
{KlaussCPU::STIDX32_SH, 1, 0x5E200000u, 0xFFF0000Fu, 3, {{F_RD, 0}, {F_RS1, 1}, {F_SH_M2, 2}}},
{KlaussCPU::STIDX64_SH, 1, 0x5F300000u, 0xFFF0000Fu, 3, {{F_RD, 0}, {F_RS1, 1}, {F_SH_M3, 2}}},
{KlaussCPU::STIDX64U_SH, 1, 0x5F200000u, 0xFFF0000Fu, 3, {{F_RD, 0}, {F_RS1, 1}, {F_SH_M3, 2}}},
{KlaussCPU::JMP_SH, 1, 0x61000000u, 0xFFFC0000u, 1, {{F_PC18, 0}}},
{KlaussCPU::JMPZ_SH, 1, 0x61080000u, 0xFFFC0000u, 1, {{F_PC18, 0}}},
{KlaussCPU::JMPNZ_SH, 1, 0x610C0000u, 0xFFFC0000u, 1, {{F_PC18, 0}}},
{KlaussCPU::JMPC_SH, 1, 0x61100000u, 0xFFFC0000u, 1, {{F_PC18, 0}}},
{KlaussCPU::JMPNC_SH, 1, 0x61140000u, 0xFFFC0000u, 1, {{F_PC18, 0}}},
{KlaussCPU::JMPO_SH, 1, 0x61180000u, 0xFFFC0000u, 1, {{F_PC18, 0}}},
{KlaussCPU::JMPNO_SH, 1, 0x611C0000u, 0xFFFC0000u, 1, {{F_PC18, 0}}},
{KlaussCPU::JMPS_SH, 1, 0x61200000u, 0xFFFC0000u, 1, {{F_PC18, 0}}},
{KlaussCPU::JMPNS_SH, 1, 0x61240000u, 0xFFFC0000u, 1, {{F_PC18, 0}}},
{KlaussCPU::JMPLT_SH, 1, 0x61280000u, 0xFFFC0000u, 1, {{F_PC18, 0}}},
{KlaussCPU::JMPGE_SH, 1, 0x612C0000u, 0xFFFC0000u, 1, {{F_PC18, 0}}},
{KlaussCPU::JMPLE_SH, 1, 0x61300000u, 0xFFFC0000u, 1, {{F_PC18, 0}}},
{KlaussCPU::JMPGT_SH, 1, 0x61340000u, 0xFFFC0000u, 1, {{F_PC18, 0}}},
{KlaussCPU::JMPULT_SH, 1, 0x61380000u, 0xFFFC0000u, 1, {{F_PC18, 0}}},
{KlaussCPU::JMPUGE_SH, 1, 0x613C0000u, 0xFFFC0000u, 1, {{F_PC18, 0}}},
{KlaussCPU::JMPULE_SH, 1, 0x61400000u, 0xFFFC0000u, 1, {{F_PC18, 0}}},
{KlaussCPU::JMPUGT_SH, 1, 0x61440000u, 0xFFFC0000u, 1, {{F_PC18, 0}}},
{KlaussCPU::JMPE_SH, 1, 0x61480000u, 0xFFFC0000u, 1, {{F_PC18, 0}}},
{KlaussCPU::JMPNE_SH, 1, 0x614C0000u, 0xFFFC0000u, 1, {{F_PC18, 0}}},
{KlaussCPU::ENTER_I, 1, 0x66000000u, 0xFFC00000u, 1, {{F_ENTER22, 0}}},
{KlaussCPU::FBR_RR, 1, 0x74000000u, 0xFC200000u, 4, {{F_RS1, 0}, {F_RS2, 1}, {F_FBRCC, 2}, {F_PC13, 3}}},
{KlaussCPU::FBR_RI, 1, 0x74200000u, 0xFC200000u, 4, {{F_RS1, 0}, {F_IMM4, 1}, {F_FBRCC, 2}, {F_PC13, 3}}},
